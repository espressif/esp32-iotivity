## main/Kconfig.projbuild
```kconfig
menu "IoTivity Example Configuration"

config WIFI_SSID
    string "WiFi SSID"
	default "myssid"
	help
		SSID (network name) for the ESP32 to connect to.

config WIFI_PASSWORD
    string "WiFi Password"
	default "myssid"
	help
		WiFi password (WPA or WPA2) for the ESP32 to match.
		can be blank if the network has no security set.

choice ESP32_IOTIVITY_MODE
    prompt "iotivity: mode select"
    default IOTIVITY_CLIENT
    help
        select iotvity mode(client/server).

config IOTIVITY_CLIENT
    bool "iotivity client"
 
config IOTIVITY_SERVER
    bool "iotivity server"
 
endchoice

config OC_DEBUG
    bool "OC_DEBUG"
    help
        enable or disable IoTivity-constrained debug

config APP_DEBUG
    bool "APP_DEBUG"
    help
        enable or disable application debug

endmenu
```

## sdkconfig.defaults
```kconfig
# Default sdkconfig parameters to use the IoTivity
CONFIG_IOTIVITY_SERVER=y
CONFIG_ENABLE_LIGHT=y
CONFIG_OC_DEBUG=y
CONFIG_IPV4=n
```
